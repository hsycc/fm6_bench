## targets/esp32s3_v4a/main/Kconfig.projbuild
```kconfig
menu "FM6 V4A audio benchmark"

config FM6_V4A_I2S_BCLK_GPIO
    int "I2S BCLK GPIO"
    default 4
    help
        Physical output pin used only to make the I2S transport run as it would
        in a product. The benchmark does not require a codec to be connected.

config FM6_V4A_I2S_WS_GPIO
    int "I2S WS/LRCK GPIO"
    default 5

config FM6_V4A_I2S_DOUT_GPIO
    int "I2S DOUT GPIO"
    default 6

endmenu
```

## targets/esp32s3_v4a/sdkconfig.defaults
```kconfig
CONFIG_ESP_DEFAULT_CPU_FREQ_MHZ_240=y
CONFIG_ESP_DEFAULT_CPU_FREQ_MHZ=240
CONFIG_ESP_TASK_WDT_EN=n
CONFIG_ESP_INT_WDT=n
CONFIG_COMPILER_OPTIMIZATION_PERF=y
```
